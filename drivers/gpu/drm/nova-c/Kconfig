## drivers/gpu/drm/nova-c/Kconfig
```kconfig
config DRM_NOVA_C
       tristate "Nova POC"
       depends on DRM && PCI && MMU
       depends on NOVA_CORE
       select AUXILIARY_BUS
       select DRM_TTM
       select DRM_EXEC
       select DRM_GPUVM
       select DRM_SCHED
       help
         This is HACKS
```

## drivers/gpu/nova-core/Kconfig
```kconfig
config NOVA_CORE
	tristate "Nova Core GPU driver"
	depends on PCI
	depends on RUST
	depends on RUST_FW_LOADER_ABSTRACTIONS
	default n
	help
	  Choose this if you want to build the Nova Core driver for Nvidia
	  GPUs based on the GPU System Processor (GSP). This is true for Turing
	  and later GPUs.

	  This driver is work in progress and may not be functional.

	  If M is selected, the module will be called nova_core.

config NVIDIA_OPEN_GPU_KERNEL_PATH
	string "Path to open GPU kernel modules"
	depends on NOVA_CORE
	default ""
	help
	  Path to where https://github.com/NVIDIA/open-gpu-kernel-modules
	  is checked out which will be used the headers there to generate Rust
	  bindings.

	  If unset the existing in-tree Nouveau copy of these headers will be used
	  instead.

config NOVA_DEBUGFS
	bool "Nova Core debugfs support"
	depends on NOVA_CORE
	depends on DEBUG_FS
	default y
	help
	  Enable debugfs support for the Nova driver. Pass the debugfs file to
	  xxd -r -p to get the binary file and then pass that to nvlog_decoder:
	  nvlog_decoder --input-file rm_log.bin --elf gsp_log.bin --d none
                        --fake-nvlog-libos GSP_LIBOS3 -t RM
```
